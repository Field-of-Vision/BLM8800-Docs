## Sample firmware and code for testing/8800m40-aic8800-sdk-6.5.7/wifi/LinuxDriver/aic8800_fdrv/Kconfig
```kconfig
config AIC8800_WLAN_SUPPORT
	tristate "AIC8800 wlan Support"
	default m
	---help---
	  This is support for aic wifi driver.
```
